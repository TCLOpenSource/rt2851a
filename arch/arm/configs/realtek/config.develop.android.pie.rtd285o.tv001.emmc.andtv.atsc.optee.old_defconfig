## drivers/net/wireless/mediatek/mt7638/Kconfig
```kconfig
config MT7638
       tristate "MediaTek MT7638 support"
       depends on MAC80211
       select CFG80211_WEXT
       select WEXT_CORE
       ---help---
         this adds support for MT7668-based wireless module

config MTK_COMBO_WIFI_HIF
       depends on MT7638
       string "MediaTek combo wifi HIF"
       default "usb"
```

## drivers/rtk_kdriver/japan4k_dmx/Kconfig
```kconfig
config RTK_KDRV_JAPAN4k_DMX
	bool "Enable Realtek JAPAN4k DMX Driver"
	default n
	help
	
```

## drivers/tee/optee/Kconfig
```kconfig
# OP-TEE Trusted Execution Environment Configuration
config OPTEE
	tristate "OP-TEE"
	depends on HAVE_ARM_SMCCC
	depends on MMU
	help
	  This implements the OP-TEE Trusted Execution Environment (TEE)
	  driver.
config OPTEE_SECURE_SVP_PROTECTION
	tristate "SVP Protection"
	depends on OPTEE
	help
	  Set SVP Protection in OPTEE
config OPTEE_SUPPORT_VERSION_3_X
	default n
	tristate "SUPPORT OPTEE 3.X"
	depends on OPTEE
	help
	  SUPPORT OPTEE VERSION 3.X
```
